## config/west.yml
```yaml
manifest:
  remotes:
    - name: zmkfirmware
      url-base: https://github.com/zmkfirmware
    #  - name: urob
    #  url-base: https://github.com/urob
    - name: karuetech
      url-base: https://github.com/karuetech
    - name: carrefinho
      url-base: https://github.com/bukharovsi
    - name: janpfischer
      url-base: https://github.com/janpfischer
    - name: joaopedropio                          # <--- add these
      url-base: https://github.com/joaopedropio   # <---
    - name: englmaxi
      url-base: https://github.com/englmaxi
    - name: gpeye
      url-base: https://github.com/GPeye
    - name: bwshockley
      url-base: https://github.com/bwshockley
  projects:
    - name: zmk
      remote: zmkfirmware
      revision: main
      import: app/west.yml
    - name: zmk-helpers
      remote: karuetech
      revision: main
    - name: prospector-zmk-module
      remote: carrefinho
      revision: core/zephyr-4-1
      # revision: main
    - name: zmk-dongle-screen
      remote: janpfischer
      revision: main
    - name: snake-module                          # <--- and these
      remote: joaopedropio                        # <---
      revision: master                            # <---
    - name: zmk-dongle-display
      remote: englmaxi
      revision: main
    - name: mario-peripheral-animation
      remote: gpeye
      revision: main 
    - name: zmk-dongle-screen-2
      remote: karuetech
      revision: main
  self:
    path: config
```
